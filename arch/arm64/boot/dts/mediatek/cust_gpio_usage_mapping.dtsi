/*
 * Generated by MTK SP DrvGen Version: 3.5.160809 for MT6739.
 * 2019-11-11 10:46:44
 * Do Not Modify The File.
 * Copyright Mediatek Inc. (c) 2016.
*/

&gpio_usage_mapping {
	GPIO_SIM1_HOT_PLUG = <&pio 18 0>;
	GPIO_SIM2_HOT_PLUG = <&pio 19 0>;
	GPIO_SIM1_SCLK = <&pio 77 0>;
	GPIO_SIM1_SRST = <&pio 78 0>;
	GPIO_SIM1_SIO = <&pio 79 0>;
	GPIO_SIM2_SCLK = <&pio 80 0>;
	GPIO_SIM2_SRST = <&pio 81 0>;
	GPIO_SIM2_SIO = <&pio 82 0>;
};
